#include "ssd1306.h"
#include <string.h>
#include <stdarg.h>
#include <stdio.h>

static I2C_HandleTypeDef *hi2c_oled;
static uint8_t framebuffer[SSD1306_WIDTH * SSD1306_HEIGHT / 8];
static uint8_t cursor_x, cursor_y;

// 8x8 font: ASCII 32-127 (uppercase only for letters)
static const uint8_t font8x8[][8] = {
    {0x00,0x00,0x00,0x00,0x00,0x00,0x00,0x00}, // ' '
    {0x18,0x3C,0x3C,0x18,0x18,0x00,0x18,0x00}, // '!'
    {0x6C,0x6C,0x6C,0x00,0x00,0x00,0x00,0x00}, // '"'
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    {0x00,0x00,0x32,0x4C,0x00,0x00,0x00,0x00}, // '~'
};

static void ssd1306_write_cmd(uint8_t cmd) {
    uint8_t buf[2] = {0x00, cmd};
    HAL_I2C_Master_Transmit(hi2c_oled, SSD1306_I2C_ADDR, buf, 2, HAL_MAX_DELAY);
}

void SSD1306_Init(I2C_HandleTypeDef *hi2c) {
    hi2c_oled = hi2c;
    HAL_Delay(100);

    ssd1306_write_cmd(0xAE); // display off
    ssd1306_write_cmd(0xD5); // clock div
    ssd1306_write_cmd(0x80);
    ssd1306_write_cmd(0xA8); // multiplex
    ssd1306_write_cmd(0x3F); // 1/64
    ssd1306_write_cmd(0xD3); // display offset
    ssd1306_write_cmd(0x00);
    ssd1306_write_cmd(0x40); // start line = 0
    ssd1306_write_cmd(0x8D); // charge pump
    ssd1306_write_cmd(0x14); // enable
    ssd1306_write_cmd(0x20); // memory mode
    ssd1306_write_cmd(0x02); // page addressing
    ssd1306_write_cmd(0xA1); // seg remap
    ssd1306_write_cmd(0xC8); // com scan dec
    ssd1306_write_cmd(0xDA); // com pins
    ssd1306_write_cmd(0x12);
    ssd1306_write_cmd(0x81); // contrast
    ssd1306_write_cmd(0xCF);
    ssd1306_write_cmd(0xD9); // precharge
    ssd1306_write_cmd(0xF1);
    ssd1306_write_cmd(0xDB); // vcomh
    ssd1306_write_cmd(0x30);
    ssd1306_write_cmd(0xA4); // display from ram
    ssd1306_write_cmd(0xA6); // normal display
    ssd1306_write_cmd(0xAF); // display on

    SSD1306_Clear();
    SSD1306_Update();
}

void SSD1306_Clear(void) {
    memset(framebuffer, 0, sizeof(framebuffer));
    cursor_x = 0;
    cursor_y = 0;
}

void SSD1306_Update(void) {
    for (uint8_t page = 0; page < 8; page++) {
        ssd1306_write_cmd(0xB0 + page);
        ssd1306_write_cmd(0x00);
        ssd1306_write_cmd(0x10);

        uint8_t buf[129];
        buf[0] = 0x40; // data prefix
        memcpy(&buf[1], &framebuffer[page * 128], 128);
        HAL_I2C_Master_Transmit(hi2c_oled, SSD1306_I2C_ADDR, buf, 129, HAL_MAX_DELAY);
    }
}

void SSD1306_SetCursor(uint8_t x, uint8_t y) {
    cursor_x = x;
    cursor_y = y;
}

static void ssd1306_draw_char(uint8_t x, uint8_t page, char ch) {
    if (ch < 32 || ch > 126) ch = ' ';
    uint8_t idx = ch - 32;
    for (uint8_t i = 0; i < 8; i++) {
        if (x + i < SSD1306_WIDTH) {
            framebuffer[page * 128 + x + i] = font8x8[idx][i];
        }
    }
}

void SSD1306_WriteChar(char ch) {
    if (ch == '\n') {
        cursor_x = 0;
        cursor_y++;
        if (cursor_y >= 8) cursor_y = 0;
        return;
    }
    ssd1306_draw_char(cursor_x * 8, cursor_y, ch);
    cursor_x++;
    if (cursor_x >= 16) {
        cursor_x = 0;
        cursor_y++;
        if (cursor_y >= 8) cursor_y = 0;
    }
}

void SSD1306_WriteString(const char *str) {
    while (*str) {
        SSD1306_WriteChar(*str++);
    }
}

void SSD1306_Printf(const char *fmt, ...) {
    char buf[64];
    va_list args;
    va_start(args, fmt);
    vsnprintf(buf, sizeof(buf), fmt, args);
    va_end(args);
    SSD1306_WriteString(buf);
}
